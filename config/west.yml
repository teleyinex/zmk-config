## config/west.yml
```yaml
manifest:
  remotes:
    - name: zmkfirmware
      url-base: https://github.com/zmkfirmware
    - name: cormoran
      url-base: https://github.com/cormoran
  projects:
    - name: zmk
      remote: zmkfirmware
      revision: v0.3
      import: app/west.yml
    - name: zmk-feature-default-layer
      remote: cormoran
      revision: 9543cc4a3afdf0400ed477a93e6f79b1fb4927e3 # last commit compatible with zmk v0.3 (before "Migrate to zmk v0.4")
  self:
    path: config
```
